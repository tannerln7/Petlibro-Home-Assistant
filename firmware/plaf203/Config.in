## firmware/plaf203/configs/plaf203_qemu_defconfig
```kconfig
BR2_arm=y
BR2_cortex_a7=y
BR2_ARM_EABI=y
BR2_ARM_FPU_NEON_VFPV4=y
BR2_ARM_INSTRUCTIONS_THUMB2=y
BR2_REPRODUCIBLE=y
BR2_TOOLCHAIN_EXTERNAL=y
BR2_TOOLCHAIN_EXTERNAL_CUSTOM=y
BR2_TOOLCHAIN_EXTERNAL_PREINSTALLED=y
BR2_TOOLCHAIN_EXTERNAL_PATH="/opt/plaf203-toolchain"
BR2_TOOLCHAIN_EXTERNAL_CUSTOM_PREFIX="arm-openipc-linux-musleabi"
BR2_TOOLCHAIN_EXTERNAL_GCC_13=y
BR2_TOOLCHAIN_EXTERNAL_HEADERS_4_9=y
BR2_TOOLCHAIN_EXTERNAL_CUSTOM_MUSL=y
BR2_TOOLCHAIN_EXTERNAL_CXX=y
BR2_GLOBAL_PATCH_DIR="$(BR2_EXTERNAL_PLAF203_PATH)/patches"
BR2_LINUX_KERNEL=y
BR2_LINUX_KERNEL_CUSTOM_TARBALL=y
BR2_LINUX_KERNEL_CUSTOM_TARBALL_LOCATION="file:///build/downloads/linux-bb0266a361ebc03dc258aed20119793eab4835f1.tar.gz"
BR2_LINUX_KERNEL_USE_CUSTOM_CONFIG=y
BR2_LINUX_KERNEL_CUSTOM_CONFIG_FILE="$(BR2_EXTERNAL_PLAF203_PATH)/board/linux.config"
BR2_LINUX_KERNEL_CONFIG_FRAGMENT_FILES="$(BR2_EXTERNAL_PLAF203_PATH)/board/watchdog.config"
BR2_LINUX_KERNEL_ZIMAGE=y
BR2_LINUX_KERNEL_XZ=y
BR2_LINUX_KERNEL_DTS_SUPPORT=y
BR2_LINUX_KERNEL_CUSTOM_DTS_PATH="$(BR2_EXTERNAL_PLAF203_PATH)/board/plaf203-qemu.dts"
BR2_TARGET_GENERIC_HOSTNAME="plaf203-dev"
BR2_TARGET_GENERIC_ISSUE="PLAF203 QEMU development image"
# BR2_TARGET_ENABLE_ROOT_LOGIN is not set
# BR2_TARGET_GENERIC_GETTY is not set
# BR2_TARGET_GENERIC_REMOUNT_ROOTFS_RW is not set
BR2_ROOTFS_OVERLAY="$(BR2_EXTERNAL_PLAF203_PATH)/overlay"
BR2_ROOTFS_POST_BUILD_SCRIPT="$(BR2_EXTERNAL_PLAF203_PATH)/post-build.sh"
BR2_ROOTFS_POST_IMAGE_SCRIPT="$(BR2_EXTERNAL_PLAF203_PATH)/post-image.sh"
BR2_PACKAGE_IFUPDOWN_SCRIPTS=y
BR2_PACKAGE_DROPBEAR=y
BR2_PACKAGE_PLAF203_RUNTIME=y
BR2_TARGET_ROOTFS_SQUASHFS=y
BR2_TARGET_ROOTFS_SQUASHFS4_XZ=y
# No capability/SELinux/ACL policy exists yet; do not inherit host cache ACLs.
BR2_TARGET_ROOTFS_SQUASHFS_COMP_OPTS="-no-xattrs"
# BR2_TARGET_ROOTFS_TAR is not set
```

## firmware/plaf203/package/plaf203-runtime/Config.in
```kconfig
config BR2_PACKAGE_PLAF203_RUNTIME
	bool "PLAF203 native runtime"
	help
	  Single-owner non-actuating runtime with health-gated watchdog support.
```
